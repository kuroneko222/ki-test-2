## boards/shields/ki_test_2/Kconfig.defconfig
```kconfig
if SHIELD_KI_TEST_2_LEFT

config ZMK_KEYBOARD_NAME
    default "ki_test_2"

endif

if SHIELD_KI_TEST_2_LEFT || SHIELD_KI_TEST_2_RIGHT

config ZMK_SPLIT
    default y

endif
```

## boards/shields/ki_test_2/Kconfig.shield
```kconfig
config SHIELD_KI_TEST_2_LEFT
    def_bool $(shields_list_contains,ki_test_2_left)
config SHIELD_KI_TEST_2_RIGHT
    def_bool $(shields_list_contains,ki_test_2_right)
```

## boards/shields/test_kdk01/Kconfig.defconfig
```kconfig
if SHIELD_TEST_KDK01_LEFT

config ZMK_KEYBOARD_NAME
    default "test_kdk01"

endif

if SHIELD_TEST_KDK01_LEFT || SHIELD_TEST_KDK01_RIGHT

config ZMK_SPLIT
    default y

endif
```

## boards/shields/test_kdk01/Kconfig.shield
```kconfig
config SHIELD_TEST_KDK01_LEFT
    def_bool $(shields_list_contains,test_kdk01_left)
config SHIELD_TEST_KDK01_RIGHT
    def_bool $(shields_list_contains,test_kdk01_right)
```
